## main/Kconfig.projbuild
```kconfig
menu "TFT library settings"

# EXAMPLE_DISPLAY_TYPE3 needed for M5Stack
config EXAMPLE_DISPLAY_TYPE
    int
    default 0 if EXAMPLE_DISPLAY_TYPE0
    default 1 if EXAMPLE_DISPLAY_TYPE1
    default 2 if EXAMPLE_DISPLAY_TYPE2
    default 3 if EXAMPLE_DISPLAY_TYPE3

    choice
        prompt "Select predefined display configuration"
        default EXAMPLE_DISPLAY_TYPE0
        help
            Select predefined display configuration

        config EXAMPLE_DISPLAY_TYPE0
            bool "None"
        config EXAMPLE_DISPLAY_TYPE1
            bool "ESP-WROVER-KIT Display"
        config EXAMPLE_DISPLAY_TYPE2
            bool "Adafruit TFT Feather display"
        config EXAMPLE_DISPLAY_TYPE3
            bool "M5Stack TFT display"
    endchoice

endmenu
```
